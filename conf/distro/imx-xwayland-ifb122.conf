## conf/distro/imx-xwayland-ifb122.conf
```bitbake
#@NAME: IFB122 Embedded System
#@SOC: i.MX6UL
#@DESCRIPTION: Distro configuration for IFB122 Embedded System

require conf/distro/fsl-imx-xwayland.conf

DISTRO_VERSION = "1.0.3"
```

## conf/distro/imx-xwayland-rbox630-6dl.conf
```bitbake
#@NAME: rBOX630 Embedded Box PC
#@SOC: i.MX6DL
#@DESCRIPTION: Distro configuration for rBOX630 Embedded Box PC

require conf/distro/fsl-imx-xwayland.conf

DISTRO_VERSION = "1.0.3"
```

## conf/layer.conf
```bitbake
# We have a conf and classes directory, add to BBPATH
BBPATH .= ":${LAYERDIR}"

# We have recipes-* directories, add to BBFILES
BBFILES += "${LAYERDIR}/recipes-*/*/*.bb \
            ${LAYERDIR}/recipes-*/*/*.bbappend"

BBFILE_COLLECTIONS += "meta-axiomtek"
BBFILE_PATTERN_meta-axiomtek = "^${LAYERDIR}/"
BBFILE_PRIORITY_meta-axiomtek = "6"

LAYERDEPENDS_meta-axiomtek = "core"
LAYERSERIES_COMPAT_meta-axiomtek = "hardknott"
```

## conf/machine/ifb122.conf
```bitbake
#@TYPE: Machine
#@NAME: Axiomtek IFB122 Embedded System
#@SOC: i.MX6UL
#@DESCRIPTION: Machine configuration for Axiomtek IFB122 Embedded System

MACHINEOVERRIDES =. "mx6:mx6ul:"

include conf/machine/include/imx-base.inc
include conf/machine/include/tune-cortexa7.inc

MACHINE_FEATURES += " pci wifi bluetooth bcm4339 bcm43455"

KERNEL_DEVICETREE = " \
	imx6ul-ifb122-a2.dtb \
	imx6ul-ifb122-a3.dtb \
"
UBOOT_CONFIG ??= "sd"
UBOOT_CONFIG[sd]       = "ifb122_config,sdcard"
UBOOT_CONFIG[sd-optee] = "ifb122_config,sdcard"
UBOOT_CONFIG[emmc]     = "ifb122_config,sdcard"
UBOOT_CONFIG[qspi1]    = "ifb122_config"
UBOOT_CONFIG[mfgtool]  = "ifb122_config"

OPTEE_BIN_EXT = "6ulevk"
OPTEE_WKS_FILE_DEPENDS         = ""

COPY_LIC_MANIFEST = "1"
COPY_LIC_DIRS = "1"
LICENSE_CREATE_PACKAGE = "1"

INHERIT += "image-buildinfo"

PREFERRED_PROVIDER_virtual/java-initial-native = "cacao-initial-native"
PREFERRED_PROVIDER_virtual/java-native = "cacao-native"
PREFERRED_PROVIDER_virtual/javac-native = "ecj-bootstrap-native"


IMAGE_INSTALL_append = " pbzip2 tar ax-info sys-led gstreamer1.0-plugins-imx \
                         ftpd xinetd netkit-telnet quectel-cm modemmanager \
                         stress-ng libaxeapi libaxeapi-dev bc ncurses \
                         axeapi \
			 lighttpd lighttpd-module-openssl lighttpd-module-proxy \
			 openjdk-8 \
"

#PACKAGE_EXCLUDE = " psplash packagegroup-core-weston \
#"
```

## conf/machine/rbox630-6dl.conf
```bitbake
#@TYPE: Machine
#@NAME: Axiomtek rBOX630 Embedded Box PC
#@SOC: i.MX6DL
#@DESCRIPTION: Machine configuration for Axiomtek rBOX630 Embedded Box PC

MACHINEOVERRIDES =. "mx6:mx6dl:"

require conf/machine/include/imx-base.inc
require conf/machine/include/tune-cortexa9.inc

SERIAL_CONSOLES = "115200;ttymxc0"

MACHINE_FIRMWARE_append_mx6 = " linux-firmware-ath6k"

MACHINE_FEATURES += " pci wifi bluetooth bcm4339 bcm43455"

KERNEL_DEVICETREE = "imx6dl-rbox630.dtb"

UBOOT_CONFIG ??= "sd"
UBOOT_CONFIG[sd] = "rbox630_6dl_config,sdcard"
UBOOT_CONFIG[epdc] = "rbox630_6dl_config"
UBOOT_CONFIG[mfgtool] = "rbox630_6dl_config"
UBOOT_CONFIG[sd-optee] = "rbox630_6dl_config,sdcard"

OPTEE_BIN_EXT = "6dlsdb"
OPTEE_WKS_FILE_DEPENDS         = ""

COPY_LIC_MANIFEST = "1"
COPY_LIC_DIRS = "1"
LICENSE_CREATE_PACKAGE = "1"

INHERIT += "image-buildinfo"

IMAGE_INSTALL_append = " pbzip2 tar ax-info sys-led gstreamer1.0-plugins-imx \
                         ftpd xinetd netkit-telnet quectel-cm modemmanager \
                         stress-ng libaxeapi libaxeapi-dev bc ncurses \
                         axeapi \
"
```
